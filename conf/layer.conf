## conf/layer.conf
```bitbake
# We have a conf and classes directory, add to BBPATH
BBPATH .= ":${LAYERDIR}"

# We have recipes-* directories, add to BBFILES
BBFILES += "${LAYERDIR}/recipes-*/*/*.bb \
            ${LAYERDIR}/recipes-*/*/*.bbappend"

BBFILE_COLLECTIONS += "meta-adv-tsu"
BBFILE_PATTERN_meta-adv-tsu = "^${LAYERDIR}/"
BBFILE_PRIORITY_meta-adv-tsu = "6"

LAYERDEPENDS_meta-adv-tsu = "core"
LAYERSERIES_COMPAT_meta-adv-tsu = "scarthgap"

TOOLCHAIN_TARGET_TASK:append = " kernel-devsrc kernel-modules kernel-dev"
IMAGE_INSTALL:append = " e2fsprogs-resize2fs parted"
IMAGE_INSTALL:append = " tpm2-tools tpm2-tss"
PACKAGECONFIG:append:pn-tpm2-tss = " tcti-device"
IMAGE_INSTALL:append = " libtss2-tcti-device"
IMAGE_INSTALL:append = " udev-rules-imx"
```
